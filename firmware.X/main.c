/* 
 * File:   main.c
 * Author: Juan Andres Valverde
 * Created on May 5, 2013, 1:17 AM
 */

#include <p30f4011.h>
//#include <stdio.h>
//#include <stdlib.h>
#include <xc.h>
//#include <libpic30.h>

//_FOSC(FRC_PLL16 & CSW_FSCM_OFF)// //Fosc=16x7.37MHz=117.92Mhz, Fcy=29.48MHz=29.48MIPS
////_FOSC(0xC303)
//_FWDT(WDTPSB_16 & WDTPSA_512 & WDT_OFF)
//_FBORPOR(PWRT_OFF & BORV27 & PBOR_ON & PWMxL_ACT_HI & PWMxH_ACT_HI & RST_PWMPIN & MCLR_EN)
//_FGS(GWRP_OFF & CODE_PROT_OFF)
//_FICD(ICS_PGD)
#pragma config FPR = FRC_PLL16
#pragma config FOS = PRI
#pragma config FCKSMEN = CSW_FSCM_OFF
#pragma config WDT = WDT_OFF
#pragma config FPWRT = PWRT_OFF//4
#pragma config BODENV = BORV27
#pragma config BOREN = PBOR_OFF//PBOR_ON
#pragma config MCLRE = MCLR_EN
#pragma config ICS = ICS_PGD
#pragma config GCP = CODE_PROT_OFF

//ADC interrupt, global variables and functions
#include <adc10.h>

unsigned int adc_n=0;
unsigned int adc[2];
double adc_vol[2];
double adc_sen[2];

void __attribute__((__interrupt__,no_auto_psv)) _ADCInterrupt(void){
    ADCON1bits.ADON = 0;    // ADC OFF */

    if(adc_n==0){
        ADCHSbits.CH0SA=1;
        adc[0]=(ADCBUF0+ADCBUF1+ADCBUF2+ADCBUF3+ADCBUF4+ADCBUF5+ADCBUF6+ADCBUF7+ADCBUF8+ADCBUF9+ADCBUFA+ADCBUFB+ADCBUFC+ADCBUFD+ADCBUFE+ADCBUFF)>>4;//10bits 4, 8bits 6
        adc_n=1;
    } else{
        ADCHSbits.CH0SA=0;
        adc[1]=(ADCBUF0+ADCBUF1+ADCBUF2+ADCBUF3+ADCBUF4+ADCBUF5+ADCBUF6+ADCBUF7+ADCBUF8+ADCBUF9+ADCBUFA+ADCBUFB+ADCBUFC+ADCBUFD+ADCBUFE+ADCBUFF)>>4;
        adc_n=0;
    }

    IFS0bits.ADIF = 0;      // Clear ADC interrupt flag */
    ADCON1bits.ADON = 1;    // ADC ON */
}
void vol_val(void){
   adc_vol[0]=adc[0]*0.00489;//10bits 0.00489, 8bits 0.0196
   adc_vol[1]=adc[1]*0.00489;

   adc_sen[0]=adc_vol[0];//TPS
   adc_sen[1]=adc_vol[1]*30;//VSS
}

//TMR1 interrupt, global variables and functions
#include<timer.h>

const unsigned int ckp[2700] = {128,110,93,76,61,46,34,23,14,7,3,1,2,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136,132};
//const unsigned int ckp[12000] = {128,124,120,116,112,108,104,100,96,93,89,85,81,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112,110};

unsigned int i=0;//sample count

double f = 0;
double tm = 0;
unsigned int tmr1 = 0;
void __attribute__((__interrupt__,no_auto_psv)) _T1Interrupt(void){
	IEC0bits.T1IE = 0;  // Disable TMR1 interrupt */
	T1CONbits.TON = 0;  // Timer1 OFF */
        
        LATE=(LATE&0b100000000)|ckp[i];	//LATE=ckp[i];//CKP

	LATF=ckp[i]>>6;//CKP

        if(i==1316)//45*29+45/4=1316
            LATCbits.LATC15=~LATCbits.LATC15;   // CMP
        else if((i==472)||(i==1732))
            LATCbits.LATC13=1;  // KS
        else if((i==494)||(i==1754))
            LATCbits.LATC13=0;  // KS
        i++;
	if(i==2700) i=0;

//        if(i==2925)//100*29+100/4=1316
//            LATCbits.LATC15=~LATCbits.LATC15;   // CMP
//        else if((i==1000)||(i==3800))
//            LATCbits.LATC13=1;  // KS
//        else if((i==1100)||(i==3900))
//            LATCbits.LATC13=0;  // KS
//        i++;
//	if(i==6000) i=0;

//        if(i==5850)//100*29+100/4=1316
//            LATCbits.LATC15=~LATCbits.LATC15;   // CMP
//        else if((i==2000)||(i==7600))
//            LATCbits.LATC13=1;  // KS
//        else if((i==2200)||(i==7800))
//            LATCbits.LATC13=0;  // KS
//        i++;
//	if(i==12000) i=0;

	TMR1 = tmr1;

        IFS0bits.T1IF = 0;  // Clear Timer interrupt flag */
	T1CONbits.TON = 1;  // Timer1 ON */
        IEC0bits.T1IE = 1;  // Enable TMR1 interrupt */
}
void tiempo_tmr1(void){
    f=-5.078*adc[0]+6000;
    tm = (650900/f)-61.57;
    tmr1=65535-tm;
}

//TMR2 interrupt, global variables and functions
unsigned int tmr2 = 0;

double t_2=0;
void __attribute__((__interrupt__,no_auto_psv)) _T2Interrupt(void){
        IEC0bits.T2IE = 0;  // Disable TMR2 interrupt */
        T2CONbits.TON = 0;  // Timer2 OFF */

	LATCbits.LATC14=~LATCbits.LATC14;//VSS

        TMR2=tmr2;

	IFS0bits.T2IF = 0;  // Clear Timer2 interrupt flag */
        IEC0bits.T2IE = 1;  // Enable TMR2 interrupt */
        T2CONbits.TON = 1;  // Timer2 ON */
}
void tiempo_tmr2(void){
    if((1024-adc[1])<6){
        IEC0bits.T2IE = 0;  // Disable TMR2 interrupt */
        T2CONbits.TON = 0;  // Timer2 OFF */
        
        t_2=480000;
    }else if((1024-adc[1])>=1000){
        IEC0bits.T2IE = 1;  // Enable TMR2 interrupt */
        T2CONbits.TON = 1;  // Timer2 ON */

        t_2=3333;
    }else{
        IEC0bits.T2IE = 1;  // Enable TMR2 interrupt */
        T2CONbits.TON = 1;  // Timer2 ON */

        t_2=3333333/(1024-adc[1]);
    }
    tmr2=65535-t_2*0.11125;
}

//TMR3 interrupt, global variables and functions
void __attribute__((__interrupt__,no_auto_psv)) _T3Interrupt(void){
    IEC0bits.T3IE = 0;  // Disable TMR3 interrupt */
    T3CONbits.TON = 0;  // Timer3 OFF */

    LATEbits.LATE8=~LATEbits.LATE8;//OXI

    TMR3=9910;
    
    IFS0bits.T3IF = 0;  // Clear Timer3 interrupt flag */
    IEC0bits.T3IE = 1;  // Enable TMR3 interrupt */
    T3CONbits.TON = 1;  // Timer3 ON */
}

//UART Debug
//#define Debug_serial
#if defined(Debug_serial)
    #include<uart.h>
    #include<stdio.h>
    unsigned char option = 0;
    void __attribute__((__interrupt__,no_auto_psv)) _U1RXInterrupt(void){
        option = getcUART1();
        IFS0bits.U1RXIF = 0;	// Clear U1 interrupt flag */
    }
    void debug_PICkit(void){
        if(option=='1')
            printf("1TPS %4u %1.3f %1.3f\n",adc[0],adc_vol[0],adc_sen[0]);
        else if(option=='2')
            printf("2VSS %4u %1.3f %1.3f\n",adc[1],adc_vol[1],adc_sen[1]);
        else if(option=='q'){
            printf("1TPS %4u %1.3f %1.3f\n",adc[0],adc_vol[0],adc_sen[0]);
            printf("\t\t\t %4.0f %3.3f %4u\n",f,tm,tmr1);
            printf("2VSS %4u %1.3f %1.3f\n",adc[1],adc_vol[1],adc_sen[1]);
            printf("\t\t\t %4.0f %4u\n",t_2,tmr2);
        }
        option=0;
    }
#endif

double map=0;
unsigned int dac=0;
void map_dac(void) { // MAP
    //MAP     f = p00 + p10*x + p01*y + p20*x^2 + p11*x*y + p02*y^2;
    map = -14.49 +0.1403*adc_sen[1] +9.239*adc_sen[0] -0.0003145*adc_sen[1]*adc_sen[1] -0.03021*adc_sen[1]*adc_sen[0] -1.363*adc_sen[0]*adc_sen[0];
	
    dac=map*51;

    LATD=dac;//MAP
    LATB=dac;//MAP
}
/* 
 */

int main(){
    TRISB=0b1111111100001111;//B7-B4 4-lsb MAP
    TRISC=0b0001111111111111;//C15=0 CMP    C14=0 VSS   C13=0 KS
    TRISD=0b1111111111110000;//D4-D0 4-msb MAP
    TRISE=0b1111111011000000;//E5-E0 6-lsb CKP //E8=0 OX
    TRISF=0b1111111111111100;//D4-D0 2-msb CKP //F2=1 RX    F3=0 TX

    SetChanADC10(   ADC_CH0_POS_SAMPLEA_AN0 & ADC_CH0_NEG_SAMPLEA_VREFN);//Channel
    OpenADC10(      ADC_MODULE_ON & ADC_IDLE_CONTINUE &
                    ADC_FORMAT_INTG & ADC_CLK_AUTO &
                    ADC_SAMPLE_SIMULTANEOUS & ADC_AUTO_SAMPLING_ON,//Adcon1_reg dont care ADC_SAMPLE_SIMULTANEOUS
                    ADC_VREF_AVDD_AVSS & ADC_SCAN_OFF &
                    ADC_CONVERT_CH0 & ADC_ALT_BUF_OFF &
                    ADC_SAMPLES_PER_INT_16 & ADC_ALT_INPUT_OFF,//Adcon2_reg
                    ADC_SAMPLE_TIME_1 & ADC_CONV_CLK_SYSTEM & //ADC_SAMPLE_TIME_1
                    ADC_CONV_CLK_5Tcy ,//Adcon3_reg  ADC_CONV_CLK_5Tcy .fast 2Tcy
                    ENABLE_AN0_ANA & ENABLE_AN1_ANA,//PinConfig
                    SCAN_NONE);//Scanselect
    ConfigIntADC10(ADC_INT_PRI_4 & ADC_INT_ENABLE);

    #if defined(Debug_serial)
    OpenUART1(	UART_EN & UART_IDLE_CON & UART_RX_TX &
                UART_DIS_WAKE & UART_DIS_LOOPBACK  &
                UART_EN_ABAUD & UART_NO_PAR_8BIT  &
                UART_1STOPBIT,//U1MODEvalue
                UART_INT_TX_BUF_EMPTY  &
                UART_TX_PIN_NORMAL &
                UART_TX_ENABLE & UART_INT_RX_CHAR &
                UART_ADR_DETECT_DIS &
                UART_RX_OVERRUN_CLEAR,//U1STAvalue
                47);//U2BRG = (Fcy/(16*BaudRate))-1 = (29,48M/(16*38400))-1 = 47//38400   //2800=657
    ConfigIntUART1( UART_RX_INT_EN & UART_RX_INT_PR4 &
                    UART_TX_INT_DIS & UART_TX_INT_PR4);
    #endif
    
    OpenTimer1( T1_ON & T1_IDLE_CON &
                T1_GATE_OFF & T1_PS_1_1 &
                T1_SYNC_EXT_OFF & T1_SOURCE_INT,
                0xFFFF);//match_value
    ConfigIntTimer1(T1_INT_PRIOR_7 & T1_INT_ON);

    OpenTimer2( T2_ON & T2_IDLE_CON &
            T2_GATE_OFF & T2_PS_1_256 &
            T2_32BIT_MODE_OFF & T2_SOURCE_INT,
            0xFFFF);//match_value
    ConfigIntTimer2(T2_INT_PRIOR_4 & T2_INT_ON);
    
    OpenTimer3( T3_ON & T3_IDLE_CON &
                T3_GATE_OFF & T3_PS_1_256 &
                T3_SOURCE_INT, 0xFFFF);//match_value
    ConfigIntTimer3(T3_INT_PRIOR_4 & T3_INT_ON);
    
    while(1){
        vol_val();
        tiempo_tmr1();
        tiempo_tmr2();
        map_dac();
        
        #if defined(Debug_serial)
        debug_PICkit();
        #endif
    }
    return 0;
}